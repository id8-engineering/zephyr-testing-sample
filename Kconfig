## Kconfig
```kconfig
# SPDX-FileCopyrightText: Copyright 2026 ID8 Engineering AB
# SPDX-License-Identifier: Apache-2.0

rsource "lib/Kconfig"
```

## lib/Kconfig
```kconfig
# SPDX-FileCopyrightText: Copyright 2026 ID8 Engineering AB
# SPDX-License-Identifier: Apache-2.0

menu "Libraries"

rsource "publisher/Kconfig"
rsource "temp_humidity_sensor/Kconfig"

endmenu
```

## lib/environment/Kconfig
```kconfig
# SPDX-FileCopyrightText: Copyright 2026 ID8 Engineering AB
# SPDX-License-Identifier: Apache-2.0

config ENVIRONMENT_FAKE
	bool "Fake environment"
	help
	  Return configured temperature and humidity values without
	  physical hardware. Intended for development and testing.

if ENVIRONMENT_FAKE

config ENVIRONMENT_FAKE_TEMPERATURE_MC
	int "Fake temperature in milli degrees Celsius"
	default 21500
	help
	  Temperature returned by the fake environment, in milli degrees
	  Celsius (21500 = 21.5 °C).

config ENVIRONMENT_FAKE_HUMIDITY_MPCT
	int "Fake relative humidity in milli percent"
	default 45000
	range 0 100000
	help
	  Relative humidity returned by the fake environment, in milli
	  percent (45000 = 45.0 %RH).

endif # ENVIRONMENT_FAKE
```

## lib/publisher/Kconfig
```kconfig
# SPDX-FileCopyrightText: Copyright 2026 ID8 Engineering AB
# SPDX-License-Identifier: Apache-2.0

config TELEMETRY_PUBLISHER_LOG
	bool "Telemetry logger publisher"
	depends on LOG
	help
	  Publish telemetry records to the Zephyr log.
```

## lib/telemetry/Kconfig
```kconfig
# SPDX-FileCopyrightText: Copyright 2026 ID8 Engineering AB
# SPDX-License-Identifier: Apache-2.0

config TELEMETRY
	bool "Telemetry records"
	select JSON_LIBRARY
	help
	  Create telemetry records from environment readings, with a
	  sequence number and system uptime, and encode them as JSON.
```

## lib/temp_humidity_sensor/Kconfig
```kconfig
# SPDX-FileCopyrightText: Copyright 2026 ID8 Engineering AB
# SPDX-License-Identifier: Apache-2.0

config TEMP_HUMIDITY_SENSOR_FAKE
	bool "Fake temperature and humidity sensor"
	help
	  Return configured temperature and humidity values without
	  physical hardware. Intended for development and testing.

if TEMP_HUMIDITY_SENSOR_FAKE

config TEMP_HUMIDITY_SENSOR_FAKE_TEMPERATURE_MC
	int "Fake temperature in milli degrees Celsius"
	default 21500
	help
	  Temperature returned by the fake sensor, in milli degrees
	  Celsius (21500 = 21.5 °C).

config TEMP_HUMIDITY_SENSOR_FAKE_HUMIDITY_MPCT
	int "Fake relative humidity in milli percent"
	default 45000
	range 0 100000
	help
	  Relative humidity returned by the fake sensor, in milli percent
	  (45000 = 45.0 %RH).

config TEMP_HUMIDITY_SENSOR_FAKE_FAIL
	bool "Simulate a read failure"
	help
	  Make every read from the fake sensor fail with -EIO.

endif # TEMP_HUMIDITY_SENSOR_FAKE
```

## tests/lib/environment/testcase.yaml
```yaml
tests:
  zephyr_testing_sample.lib.environment_fake:
    tags: environment
    platform_allow:
      - native_sim
    integration_platforms:
      - native_sim
```

## tests/lib/logger_publisher/testcase.yaml
```yaml
tests:
  zephyr_testing_sample.lib.logger_publisher:
    tags: publisher
    platform_allow:
      - native_sim
    integration_platforms:
      - native_sim
```

## tests/lib/telemetry/testcase.yaml
```yaml
tests:
  zephyr_testing_sample.lib.telemetry:
    tags: telemetry
    platform_allow:
      - native_sim
    integration_platforms:
      - native_sim
```
