## CMakeLists.txt
```
# SPDX-FileCopyrightText: Copyright 2026 ID8 Engineering AB
# SPDX-License-Identifier: Apache-2.0

cmake_minimum_required(VERSION 3.20.0)
find_package(Zephyr REQUIRED HINTS $ENV{ZEPHYR_BASE})
project(logger_publisher_test)
target_sources(app PRIVATE src/main.c)
```

## prj.conf
```kconfig
CONFIG_ZTEST=y
CONFIG_LOG=y
CONFIG_TELEMETRY_PUBLISHER_LOG=y

# Print each log line before the test continues, so it ends up next to the
# test that produced it in the output.
CONFIG_LOG_MODE_IMMEDIATE=y
```

## src/main.c
```c
/*
 * SPDX-FileCopyrightText: Copyright 2026 ID8 Engineering AB
 * SPDX-License-Identifier: Apache-2.0
 */

#include <errno.h>
#include <stddef.h>

#include <zephyr/ztest.h>

#include <app/lib/publisher.h>

ZTEST_SUITE(logger_publisher, NULL, NULL, NULL, NULL, NULL);

ZTEST(logger_publisher, test_publish_known_record)
{
	const struct telemetry_record record = {
		.seq = 56,
		.uptime_ms = 1000,
		.temperature_mc = 180000,
		.humidity_mpct = 75000,
	};

	zassert_ok(telemetry_publish(&record));
}

ZTEST(logger_publisher, test_publish_null_returns_einval)
{
	zassert_equal(telemetry_publish(NULL), -EINVAL);
}
```
