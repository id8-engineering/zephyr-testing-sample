## CMakeLists.txt
```
# SPDX-FileCopyrightText: Copyright 2026 ID8 Engineering AB
# SPDX-License-Identifier: Apache-2.0

cmake_minimum_required(VERSION 3.20.0)
find_package(Zephyr REQUIRED HINTS $ENV{ZEPHYR_BASE})
project(environment_test)
target_sources(app PRIVATE src/main.c)
```

## prj.conf
```kconfig
CONFIG_ZTEST=y
CONFIG_ENVIRONMENT_FAKE=y

# Differ from the Kconfig defaults so the test proves that the configured
# values are returned, not values hard-coded to match the defaults.
CONFIG_ENVIRONMENT_FAKE_TEMPERATURE_MC=-12345
CONFIG_ENVIRONMENT_FAKE_HUMIDITY_MPCT=67890
```

## src/main.c
```c
/*
 * SPDX-FileCopyrightText: Copyright 2026 ID8 Engineering AB
 * SPDX-License-Identifier: Apache-2.0
 */

#include <errno.h>
#include <stddef.h>

#include <zephyr/ztest.h>

#include <app/lib/environment.h>

ZTEST_SUITE(environment_fake, NULL, NULL, NULL, NULL, NULL);

ZTEST(environment_fake, test_read_returns_configured_values)
{
	struct environment_reading reading;

	zassert_ok(environment_read(&reading));

	zassert_equal(reading.temperature_mc, CONFIG_ENVIRONMENT_FAKE_TEMPERATURE_MC);
	zassert_equal(reading.humidity_mpct, CONFIG_ENVIRONMENT_FAKE_HUMIDITY_MPCT);
}

ZTEST(environment_fake, test_read_null_returns_einval)
{
	zassert_equal(environment_read(NULL), -EINVAL);
}
```
