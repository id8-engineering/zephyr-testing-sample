## CMakeLists.txt
```
cmake_minimum_required(VERSION 3.20.0)
find_package(Zephyr REQUIRED HINTS $ENV{ZEPHYR_BASE})
project(zephyr_testing_sample)
target_sources(app PRIVATE src/main.c)
```

## Kconfig
```
# SPDX-FileCopyrightText: Copyright 2026 ID8 Engineering AB
# SPDX-License-Identifier: Apache-2.0

source "Kconfig.zephyr"
```

## sample.yaml
```
sample:
  name: Zephyr Testing Sample
  description: Reference application publishing telemetry records to the log
common:
  harness: console
  harness_config:
    type: multi_line
    ordered: true
    regex:
      - '"seq":0,"uptime_ms":\d+,"temperature_mc":21500,"humidity_mpct":45000'
      - '"seq":1,"uptime_ms":\d+,"temperature_mc":21500,"humidity_mpct":45000'
      - '"seq":2,"uptime_ms":\d+,"temperature_mc":21500,"humidity_mpct":45000'
  # Sample faster than the 10 s default so testing does not need to wait 20 s.
  extra_configs:
    - CONFIG_TELEMETRY_APP_SAMPLE_INTERVAL_MS=1000
tests:
  zephyr_testing_sample.telemetry_log:
    platform_allow:
      - native_sim
      - qemu_cortex_m3
      - seven/nrf9151
    integration_platforms:
      - native_sim
      - qemu_cortex_m3
```

## prj.conf
```kconfig
CONFIG_LOG=y
CONFIG_TELEMETRY_PUBLISHER_LOG=y
CONFIG_ENVIRONMENT_FAKE=y
CONFIG_TELEMETRY_APP=y
```

## src/main.c
```c
/*
 * SPDX-FileCopyrightText: Copyright 2026 ID8 Engineering AB
 * SPDX-License-Identifier: Apache-2.0
 */

#include <app/lib/telemetry_app.h>

int main(void)
{
	telemetry_app_start();

	return 0;
}
```
