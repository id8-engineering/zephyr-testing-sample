## CMakeLists.txt
```
cmake_minimum_required(VERSION 3.20.0)
find_package(Zephyr REQUIRED HINTS $ENV{ZEPHYR_BASE})
project(zephyr_testing_sample)
target_sources(app PRIVATE src/main.c)
```

## sample.yaml
```
sample:
  name: Zephyr Testing Sample
  description: Reference application publishing telemetry records to the log
common:
  harness: console
  harness_config:
    type: one_line
    regex:
      - "temperature_mc=21500 humidity_mpct=45000"
tests:
  zephyr_testing_sample.telemetry_log:
    platform_allow:
      - native_sim
      - qemu_cortex_m3
      - seven/nrf9151
    integration_platforms:
      - native_sim
      - qemu_cortex_m3
```

## prj.conf
```kconfig
CONFIG_LOG=y
CONFIG_TELEMETRY_PUBLISHER_LOG=y
CONFIG_ENVIRONMENT_FAKE=y
CONFIG_TELEMETRY=y
```

## src/main.c
```c
/*
 * SPDX-FileCopyrightText: Copyright 2026 ID8 Engineering AB
 * SPDX-License-Identifier: Apache-2.0
 */

#include <zephyr/kernel.h>
#include <zephyr/logging/log.h>

#include <app/lib/publisher.h>
#include <app/lib/telemetry.h>

LOG_MODULE_REGISTER(main, LOG_LEVEL_INF);

#define TESTTIME 5

int main(void)
{
	struct telemetry_record record;
	int error;

	while (true) {
		error = telemetry_record_create(&record);
		if (error < 0) {
			LOG_ERR("Failed to create telemetry record: %d", error);
		} else {
			error = telemetry_publish(&record);
			if (error < 0) {
				LOG_ERR("Failed to publish telemetry record: %d", error);
			}
		}

		k_sleep(K_SECONDS(TESTTIME));
	}

	return 0;
}
```
