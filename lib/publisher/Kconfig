## lib/publisher/Kconfig
```kconfig
# SPDX-FileCopyrightText: Copyright 2026 ID8 Engineering AB
# SPDX-License-Identifier: Apache-2.0

config TELEMETRY_PUBLISHER_LOG
	bool "Telemetry logger publisher"
	depends on LOG
	select TELEMETRY
	help
	  Encode telemetry records as JSON and publish them to the Zephyr log.
```

## lib/telemetry_app/Kconfig
```kconfig
# SPDX-FileCopyrightText: Copyright 2026 ID8 Engineering AB
# SPDX-License-Identifier: Apache-2.0

config TELEMETRY_APP
	bool "Telemetry application"
	select TELEMETRY
	select TELEMETRY_QUEUE
	help
	  Take a sensor reading every sampling interval, add it as a
	  telemetry record to the telemetry queue and publish the queued
	  records, oldest first. A record stays in the queue until it has
	  been published, or until it is discarded because the queue is
	  full. Sampling and publishing run on two workqueues of their own.

if TELEMETRY_APP

config TELEMETRY_APP_SAMPLE_INTERVAL_MS
	int "Sampling interval in milliseconds"
	default 10000
	range 1 3600000
	help
	  Time between two telemetry readings. Lower it to observe
	  several records quickly, for example in tests.

endif # TELEMETRY_APP
```

## lib/telemetry_queue/Kconfig
```kconfig
# SPDX-FileCopyrightText: Copyright 2026 ID8 Engineering AB
# SPDX-License-Identifier: Apache-2.0

config TELEMETRY_QUEUE
	bool "Telemetry record queue"
	help
	  Buffer telemetry records in a fixed-size FIFO queue. When the
	  queue is full, the oldest record is discarded.
```

## tests/lib/telemetry_app/testcase.yaml
```yaml
tests:
  zephyr_testing_sample.lib.telemetry_app:
    tags: telemetry_app
    platform_allow:
      - native_sim
    integration_platforms:
      - native_sim
```

## tests/lib/telemetry_queue/testcase.yaml
```yaml
tests:
  zephyr_testing_sample.lib.telemetry_queue:
    tags: telemetry_queue
    platform_allow:
      - native_sim
    integration_platforms:
      - native_sim
```
